## zephyr/Kconfig
```kconfig
# cFS OSAL -- Core Flight System : Operating System Abstraction Layer

# Copyright (c) 2025 Space Cubics
# SPDX-License-Identifier: Apache-2.0

config CFS_OSAL
	bool "Enable cFS OSAL Support"
	depends on MULTITHREADING
	depends on PREEMPT_ENABLED
	depends on NUM_METAIRQ_PRIORITIES <= NUM_COOP_PRIORITIES
	select PRINTK
	help
	  This option enables the Core Flight System (cFS) Operating System Abstraction Layer (OSAL).

if CFS_OSAL

config CFS_OSAL_DYNAMIC_TASK_STACKS
	bool "Allocate OSAL task stacks when no stack is supplied"
	default n
	select THREAD_STACK_INFO
	select DYNAMIC_THREAD
	select DYNAMIC_THREAD_ALLOC
	help
	  Allow OS_TaskCreate to allocate a supervisor stack when its stack
	  pointer is NULL. Configure HEAP_MEM_POOL_SIZE for the application's
	  simultaneous task stacks and other heap users. Native thread objects
	  always use static storage; caller-supplied stacks are never freed.
	  With this option disabled, NULL stack requests return
	  OS_ERR_NOT_IMPLEMENTED and task storage uses no heap allocations.

config CFS_OSAL_TASK_REAPER_STACK_SIZE
	int "OSAL task reaper stack size"
	default 2048
	range 1024 65536
	help
	  Stack size for the lazily started native task retirement thread.
	  Task thread objects and the reaper's storage are statically reserved.
	  Supply a static-duration K_KERNEL_STACK_DEFINE object and its
	  K_KERNEL_STACK_SIZEOF usable size to OS_TaskCreate, or enable optional
	  dynamic task stacks. Task creation with USERSPACE is unsupported.

config CFS_OSAL_TIMEBASE_STACK_SIZE
	int "OSAL timebase helper stack size"
	default 2048
	range 1024 65536
	help
	  Statically reserve this many usable bytes for each timebase helper.
	  Include the stack needs of application timer and external-sync callbacks.
	  Helpers and their kernel objects never allocate memory from the heap.

config CFS_OSAL_TIMEBASE_PRIORITY
	int "OSAL timebase helper native priority"
	default 1 if NUM_PREEMPT_PRIORITIES > 1
	default 0
	range 0 0 if NUM_PREEMPT_PRIORITIES = 1
	range 0 1 if NUM_PREEMPT_PRIORITIES > 1
	help
	  Select one of the two highest preemptible Zephyr priorities for
	  timebase callback helpers. Lower numbers run first.

module = CFS_OSAL
module-str = cfs_osal
source "subsys/logging/Kconfig.template.log_config"

config APP_LINK_WITH_OSAL_PUBLIC_API
	bool "Link 'app' with OSAL public API"
	default y
	help
	  Add OSAL public header files to the 'app' include path.

endif # CFS_OSAL
```
